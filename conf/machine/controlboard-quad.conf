## conf/machine/controlboard-quad.conf
```bitbake
#@TYPE: Machine
#@NAME: ControlBoard base on i.MX6 Quad
#@SOC: i.MX6Q
#@DESCRIPTION: Machine configuration for i.MX6 ControlBoard Quad
#@MAINTAINER:

# Common settings for ControlBoard boards

include conf/machine/include/imx-base.inc
include conf/machine/include/tune-cortexa9.inc

PREFERRED_PROVIDER_virtual/kernel = "linux-controlboard"
PREFERRED_VERSION_linux-controlboard = "3.10.17"
PREFERRED_VERSION_linux-yocto = "3.10.17"

SERIAL_CONSOLE = "115200 ttymxc0"

MACHINE_FEATURES += "pci touchscreen"

KERNEL_IMAGETYPE = "uImage"

SOC_FAMILY = "mx6:mx6q:controlboard"

## TODO: should update u-boot to add our board configuration
UBOOT_MACHINE = "wandboard_quad_config"

## TODO: should update linux-kernel to add our board configuration
KERNEL_DEVICETREE = "imx6q-wandboard.dtb"

MACHINE_FEATURES += "bluetooth wifi"

MACHINE_EXTRA_RRECOMMENDS += " \
  bcm4329-nvram-config \
  bcm4330-nvram-config \
"
```
